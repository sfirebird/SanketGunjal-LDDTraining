/dts-v1/;
/plugin/;

/ {
    compatible = "brcm,bcm2711";

    fragment@0 {
        target = <&gpio>;
        _overlay_ {
            gpio_conf{
                compatible = "gpio-led";
                led_gpio = <&gpio 17 0>;  // GPIO 17 is used for the LED
            };
        };
    };
};