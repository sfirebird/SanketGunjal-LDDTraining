/dts-v1/;
/plugin/;

/ {
    compatible = "brcm,bcm2711"; // Ensure compatibility with Raspberry Pi 4

    fragment@0 {
        target = <&gpio>; // Reference the GPIO controller
        __overlay__ {
            my_gpio_device: my_gpio_device {
                compatible = "my,gpio-driver";
                gpios = <&gpio 17 1>, /* GPIO17 as output */
                        <&gpio 18 0>; /* GPIO27 as input */
                gpio-names = "gpio_out", "gpio_in";
            };
        };
    };
};
